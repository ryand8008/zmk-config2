/*
 * Copyright (c) 2020 The ZMK Contributors
 *
 * SPDX-License-Identifier: MIT
 */

#include "w_quefrency.dtsi"

&default_transform {
    col-offset = <8>;
};

/ {

    /* This kscan is for the 65% right half the 60% right half
     * may require different column and row pins
     */
    kscan0: kscan {
        col-gpios
            = <&pro_micro 20 GPIO_ACTIVE_HIGH>  // col1 in the schematic
            , <&pro_micro 19 GPIO_ACTIVE_HIGH>  // col2 in the schematic
            , <&pro_micro 18 GPIO_ACTIVE_HIGH> // col3 in the schematic
            , <&pro_micro 15 GPIO_ACTIVE_HIGH> // col4 in the schematic
            , <&pro_micro 14 GPIO_ACTIVE_HIGH> // col5 in the schematic
            , <&pro_micro 16 GPIO_ACTIVE_HIGH> // col6 in the schematic
            , <&pro_micro 10 GPIO_ACTIVE_HIGH> // col7 in the schematic 
            , <&pro_micro 5 GPIO_ACTIVE_HIGH> // col8 in the schematic 
            ;
    };
};
