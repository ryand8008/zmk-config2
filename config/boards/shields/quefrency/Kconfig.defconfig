## config/boards/shields/quefrency/Kconfig.defconfig
```kconfig
# Copyright (c) 2020 The ZMK Contributors
# SPDX-License-Identifier: MIT


if SHIELD_W_QUEFRENCY_LEFT

config ZMK_KEYBOARD_NAME
    default "w_quefrency"

config ZMK_SPLIT_ROLE_CENTRAL
    default y

endif

if SHIELD_W_QUEFRENCY_LEFT || SHIELD_W_QUEFRENCY_RIGHT

config ZMK_SPLIT
    default y

endif
```

## config/boards/shields/quefrency/Kconfig.shield
```kconfig
config SHIELD_W_QUEFRENCY_LEFT
    def_bool $(shields_list_contains,w_quefrency_left)

config SHIELD_W_QUEFRENCY_RIGHT
    def_bool $(shields_list_contains,w_quefrency_right)
```

## config/boards/shields/quefrency2/Kconfig.defconfig
```kconfig
# Copyright (c) 2020 The ZMK Contributors
# SPDX-License-Identifier: MIT


if SHIELD_QUEFRENCY_LEFT_2

config ZMK_KEYBOARD_NAME
    default "Quefrency2"

config ZMK_SPLIT_ROLE_CENTRAL
    default y

endif

if SHIELD_QUEFRENCY_LEFT_2 || SHIELD_QUEFRENCY_RIGHT_2

config ZMK_SPLIT
    default y

endif
```

## config/boards/shields/quefrency2/Kconfig.shield
```kconfig
# Copyright (c) 2020 The ZMK Contributors
# SPDX-License-Identifier: MIT

config SHIELD_QUEFRENCY_LEFT_2
    def_bool $(shields_list_contains,quefrency_l2)

config SHIELD_QUEFRENCY_RIGHT_2
    def_bool $(shields_list_contains,quefrency_r2)
```
